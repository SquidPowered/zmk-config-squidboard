## Kconfig
```kconfig
config ZMK_INPUT_PROCESSOR_JOYSTICK_WASD
    bool "Joystick WASD input processor"
    default y
    depends on ZMK_POINTING
    depends on DT_HAS_ZMK_INPUT_PROCESSOR_JOYSTICK_WASD_ENABLED
    help
      Convert relative joystick axis events to held directional key behaviors.
```

## boards/shields/squidboard/Kconfig.defconfig
```kconfig
if SHIELD_SQUIDBOARD_LEFT

config ZMK_KEYBOARD_NAME
    default "Squidboard"

config ZMK_SPLIT_ROLE_CENTRAL
    default y

config ADC
    default y

config ANALOG_INPUT
    default y

endif

if SHIELD_SQUIDBOARD_RIGHT

config SPI
    default y

config PMW3610
    default y

config PMW3610_REPORT_INTERVAL_MIN
    default 12

endif

if SHIELD_SQUIDBOARD_LEFT || SHIELD_SQUIDBOARD_RIGHT

config ZMK_SPLIT
    default y

config ZMK_POINTING
    default y

endif
```

## boards/shields/squidboard/Kconfig.shield
```kconfig
config SHIELD_SQUIDBOARD_LEFT
    def_bool $(shields_list_contains,squidboard_left)

config SHIELD_SQUIDBOARD_RIGHT
    def_bool $(shields_list_contains,squidboard_right)
```

## config/west.yml
```yaml
manifest:
  defaults:
    revision: v0.3
  remotes:
    - name: zmkfirmware
      url-base: https://github.com/zmkfirmware
    - name: badjeff
      url-base: https://github.com/badjeff
  projects:
    - name: zmk
      remote: zmkfirmware
      import: app/west.yml
    - name: zmk-pmw3610-driver
      remote: badjeff
      revision: zmk-0.3
    - name: zmk-analog-input-driver
      remote: badjeff
      revision: 2684f22ee7e2168d4393f7e63676912210a796fc
  self:
    path: config
```

## dts/bindings/input_processors/zmk,input-processor-joystick-wasd.yaml
```yaml
description: Convert relative joystick axes to four directional key behaviors

compatible: "zmk,input-processor-joystick-wasd"

include: ip_zero_param.yaml

properties:
  bindings:
    type: phandle-array
    required: true
    description: Bindings ordered as up, down, left, and right

  threshold:
    type: int
    default: 8
    description: Minimum absolute axis value that presses a direction

  release-after-ms:
    type: int
    default: 50
    description: Release delay after an axis stops reporting motion
```
